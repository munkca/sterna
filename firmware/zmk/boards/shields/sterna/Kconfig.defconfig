## firmware/zmk/boards/shields/sterna/Kconfig.defconfig
```kconfig
# Copyright (c) 2022 The ZMK Contributors
# SPDX-License-Identifier: MIT

if SHIELD_STERNA

config ZMK_KEYBOARD_NAME
    default "Sterna"

endif
```
